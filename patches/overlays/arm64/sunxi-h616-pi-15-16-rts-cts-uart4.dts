/dts-v1/;
/plugin/;

/ {
	fragment@0 {
		target = <&uart4>;
		__overlay__ {
			status = "okay";
			pinctrl-0 = <&uart4_pi_pins>, <&uart4_pi_rts_cts_pins>;
			pinctrl-names = "default";
			uart-has-rtscts;
		};
	};
};
