/dts-v1/;
/plugin/;

/ {
	fragment@0 {
		target = <&uart1>;
		__overlay__ {
			status = "okay";
			pinctrl-0 = <&uart1_pins>, <&uart1_rts_cts_pins>;
			pinctrl-names = "default";
			uart-has-rtscts;
		};
	};
};
